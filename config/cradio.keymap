/* source key position labels */
#include "zmk-helpers/key-labels/34.h"

/* activate bluetooth */
#define CONFIG_WIRELESS

#define HOST_OS 2

/* source the main keymap */
#include "base_cradio.keymap"
